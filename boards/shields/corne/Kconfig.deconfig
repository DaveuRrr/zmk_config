## boards/shields/corne/Kconfig.deconfig
```kconfig
if SHIELD_DONGLE

config ZMK_KEYBOARD_NAME
    default "Corne BLE"

config ZMK_SPLIT_BLE_ROLE_CENTRAL
    default y

config ZMK_USB
    default y

config ZMK_MOUSE
    default y

endif

if ZMK_DISPLAY

config I2C
    default y

config SSD1306
    default y

choice ZMK_DISPLAY_WORK_QUEUE
    default ZMK_DISPLAY_WORK_QUEUE_DEDICATED
endchoice

endif

if LVGL

config LV_Z_VDB_SIZE
    default 64

config LV_DPI_DEF
    default 148

config LV_Z_BITS_PER_PIXEL
    default 1

choice LV_COLOR_DEPTH
    default LV_COLOR_DEPTH_1
endchoice

endif

if SHIELD_SIDEBALL

config ZMK_KEYBOARD_NAME
    default "Sideball"

config SPI
    default y

endif

if SHIELD_CORNE_LEFT

config ZMK_KEYBOARD_NAME
    default "Corne Left"

endif

if SHIELD_CORNE_RIGHT

config ZMK_KEYBOARD_NAME
    default "Corne Right"

endif

if SHIELD_CORNE_LEFT || SHIELD_CORNE_RIGHT || SHIELD_DONGLE || SHIELD_SIDEBALL

config ZMK_SPLIT
    default y

config ZMK_BLE
    default y

config ZMK_MOUSE
    default y

endif
```

## boards/shields/corne/Kconfig.shield
```kconfig
config SHIELD_CORNE_LEFT
    def_bool $(shields_list_contains,corne_left)

config SHIELD_CORNE_RIGHT
    def_bool $(shields_list_contains,corne_right)

config SHIELD_CORNE_DONGLE
    def_bool $(shields_list_contains,corne_dongle)

config SHIELD_SIDEBALL
    def_bool $(shields_list_contains,sideball)
```

## config/west.yml
```yaml
manifest:
  remotes:
    #- name: zmkfirmware
    #  url-base: https://github.com/zmkfirmware
    # Additional modules containing boards/shields/custom code can be listed here as well
    # See https://docs.zephyrproject.org/3.2.0/develop/west/manifest.html#projects
    - name: zmkfirmware
      url-base: https://github.com/petejohanson
    - name: sadekbaroudi
      url-base: https://github.com/sadekbaroudi
    - name: caksoylar
      url-base: https://github.com/caksoylar
  projects:
    - name: zmk
      remote: zmkfirmware
      revision: feat/pointers-with-input-processors # feat/pointers-move-scroll
      import: app/west.yml
    - name: zmk-pmw3610-driver
      remote: sadekbaroudie
      revision: main
    - name: zmk-rgbled-widget
      remote: caksoylar
      revision: main
  self:
    path: config
```
